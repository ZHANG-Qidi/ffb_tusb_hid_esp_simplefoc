## main/Kconfig.projbuild
```kconfig
menu "FFB Master UART Configuration"

    orsource "$IDF_PATH/examples/common_components/env_caps/$IDF_TARGET/Kconfig.env_caps"

    config FFB_UART_PORT_NUM
        int "UART port number"
        range 0 2 if IDF_TARGET_ESP32 || IDF_TARGET_ESP32S3
        default 2 if IDF_TARGET_ESP32 || IDF_TARGET_ESP32S3
        range 0 1
        default 1
        help
            UART communication port number for the FFB.
            See UART documentation for available port numbers.

    config FFB_UART_BAUD_RATE
        int "UART communication speed"
        range 1200 921600
        default 921600
        help
            UART communication speed.

    config FFB_UART_RXD
        int "UART RXD pin number"
        range ENV_GPIO_RANGE_MIN ENV_GPIO_IN_RANGE_MAX
        default 17 if IDF_TARGET_ESP32S2 || IDF_TARGET_ESP32S3
        default 14 if !IDF_TARGET_ESP32H4
        default 15 if IDF_TARGET_ESP32H4
        help
            GPIO number for UART RX pin. See UART documentation for more information
            about available pin numbers for UART.

    config FFB_UART_TXD
        int "UART TXD pin number"
        range ENV_GPIO_RANGE_MIN ENV_GPIO_OUT_RANGE_MAX
        default 18 if IDF_TARGET_ESP32S2 || IDF_TARGET_ESP32S3
        default 13 if !IDF_TARGET_ESP32H4
        default 16 if IDF_TARGET_ESP32H4
        help
            GPIO number for UART TX pin. See UART documentation for more information
            about available pin numbers for UART.

    config FFB_UART_TASK_STACK_SIZE
        int "FFB UART task stack size"
        range 1024 16384
        default 4096
        help
            Defines stack size for FFB UART. Insufficient stack size can cause crash.

endmenu
```
